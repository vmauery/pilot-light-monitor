## main/Kconfig.projbuild
```kconfig
menu "Pilot Light Monitor Configuration"

    config PLM_TWILIO_SID
        string "Twilio SID"
        default "YOUR-TWILIO-SID"
        help
            Twilio SID (get this from your Twilio account)

    config PLM_TWILIO_TOKEN
        string "Twilio Token"
        default "YOUR-TWILIO-TOKEN"
        help
            Twilio TOKEN (get this from your Twilio account)

    config PLM_TWILIO_SMS_SENDER
        string "The Twilio sender phone number"
        default "+15035551212"
        help
            Twilio SMS Sender (get this from your Twilio account)

    config PLM_TWILIO_SMS_ALERT
        string "The SMS receiver phone number"
        default "+15035552323"
        help
            What phone number to send a text to for alerts

    config PLM_UPTIME_HOST
        string "The uptime host to send logs and watchdog uptime messages to"
        default "https://www.bitbucket.com"
        help
            The host that is running the uptime PHP code that accompanies
            this firmware code.

    config PLM_WIFI_SSID
        string "WiFi SSID"
        default "myssid"
        help
            SSID (network name) for the pilot light monitor to connect to.

    config PLM_WIFI_PASSWORD
        string "WiFi Password"
        default "mypassword"
        help
            WiFi password (WPA or WPA2) for the pilot light monitor to use.

    config PLM_WIFI_LISTEN_INTERVAL
        int "WiFi listen interval"
        default 3
        help
            Interval for station to listen to beacon from AP. The unit of listen interval is one beacon interval.
            For example, if beacon interval is 100 ms and listen interval is 3, the interval for station to listen
            to beacon is 300 ms.

    choice PLM_POWER_SAVE_MODE
        prompt "power save mode"
        default PLM_POWER_SAVE_MIN_MODEM
        help
            Power save mode for the esp32 to use. Modem sleep mode includes minimum and maximum power save modes.
            In minimum power save mode, station wakes up every DTIM to receive beacon. Broadcast data will not be
            lost because it is transmitted after DTIM. However, it can not save much more power if DTIM is short
            for DTIM is determined by AP.
            In maximum power save mode, station wakes up every listen interval to receive beacon. Broadcast data
            may be lost because station may be in sleep state at DTIM time. If listen interval is longer, more power
            is saved but broadcast data is more easy to lose.

        config PLM_POWER_SAVE_NONE
            bool "none"
        config PLM_POWER_SAVE_MIN_MODEM
            bool "minimum modem"
        config PLM_POWER_SAVE_MAX_MODEM
            bool "maximum modem"
    endchoice

    choice PLM_MAX_CPU_FREQ
        prompt "Maximum CPU frequency"
        default PLM_MAX_CPU_FREQ_80
        depends on PM_ENABLE
        help
            Maximum CPU frequency to use for dynamic frequency scaling.

        config PLM_MAX_CPU_FREQ_80
            bool "80 MHz"
        config PLM_MAX_CPU_FREQ_120
            bool "120 MHz"
            depends on IDF_TARGET_ESP32C2
        config PLM_MAX_CPU_FREQ_160
            bool "160 MHz"
            depends on !IDF_TARGET_ESP32C2
        config PLM_MAX_CPU_FREQ_240
            bool "240 MHz"
            depends on IDF_TARGET_ESP32 || IDF_TARGET_ESP32S2 || IDF_TARGET_ESP32S3
    endchoice

    config PLM_MAX_CPU_FREQ_MHZ
        int
        default 80 if PLM_MAX_CPU_FREQ_80
        default 120 if PLM_MAX_CPU_FREQ_120
        default 160 if PLM_MAX_CPU_FREQ_160
        default 240 if PLM_MAX_CPU_FREQ_240

    choice PLM_MIN_CPU_FREQ
        prompt "Minimum CPU frequency"
        default PLM_MIN_CPU_FREQ_10M
        depends on PM_ENABLE
        help
            Minimum CPU frequency to use for dynamic frequency scaling.
            Should be set to XTAL frequency or XTAL frequency divided by integer.

        config PLM_MIN_CPU_FREQ_40M
            bool "40 MHz (use with 40MHz XTAL)"
            depends on XTAL_FREQ_40 || XTAL_FREQ_AUTO
        config PLM_MIN_CPU_FREQ_20M
            bool "20 MHz (use with 40MHz XTAL)"
            depends on XTAL_FREQ_40 || XTAL_FREQ_AUTO
        config PLM_MIN_CPU_FREQ_10M
            bool "10 MHz (use with 40MHz XTAL)"
            depends on XTAL_FREQ_40 || XTAL_FREQ_AUTO
        config PLM_MIN_CPU_FREQ_26M
            bool "26 MHz (use with 26MHz XTAL)"
            depends on XTAL_FREQ_26 || XTAL_FREQ_AUTO
        config PLM_MIN_CPU_FREQ_13M
            bool "13 MHz (use with 26MHz XTAL)"
            depends on XTAL_FREQ_26 || XTAL_FREQ_AUTO
    endchoice

    config PLM_MIN_CPU_FREQ_MHZ
        int
        default 40 if PLM_MIN_CPU_FREQ_40M
        default 20 if PLM_MIN_CPU_FREQ_20M
        default 10 if PLM_MIN_CPU_FREQ_10M
        default 26 if PLM_MIN_CPU_FREQ_26M
        default 13 if PLM_MIN_CPU_FREQ_13M
endmenu
```

## sdkconfig.defaults
```kconfig
CONFIG_ESP_DEFAULT_CPU_FREQ_MHZ_80=y
CONFIG_ESP_DEFAULT_CPU_FREQ_MHZ=80
CONFIG_NEWLIB_TIME_SYSCALL_USE_RTC_HRT=y
CONFIG_RTC_CLK_SRC_INT_RC=y
CONFIG_BOOTLOADER_SKIP_VALIDATE_IN_DEEP_SLEEP=y
# Enable support for power management
CONFIG_PM_ENABLE=y
# Enable tickless idle mode
CONFIG_FREERTOS_USE_TICKLESS_IDLE=y
# Put related source code in IRAM
CONFIG_PM_SLP_IRAM_OPT=y
CONFIG_PM_RTOS_IDLE_OPT=y
# Disable all GPIO at light sleep
CONFIG_GPIO_ESP32_SUPPORT_SWITCH_SLP_PULL=y
CONFIG_PM_SLP_DISABLE_GPIO=y
# Enable wifi sleep iram optimization
CONFIG_ESP_WIFI_SLP_IRAM_OPT=y
```
